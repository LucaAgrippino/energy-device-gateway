## components/aggregator/Kconfig
```kconfig
menu "Aggregator Configuration"

    config AGGREGATOR_PERIOD_MS
        int "Aggregation period (ms)"
        default 500
        range 100 5000

    config IMU_STALE_TIMEOUT_MS
        int "IMU stale timeout (ms)"
        default 500

    config MODBUS_RTU_STALE_TIMEOUT_MS
        int "Modbus RTU stale timeout (ms)"
        default 3000

    config MODBUS_TCP_STALE_TIMEOUT_MS
        int "Modbus TCP stale timeout (ms)"
        default 5000

endmenu
```

## components/health/Kconfig
```kconfig
menu "Health Monitor Configuration"

    config HEALTH_PERIOD_MS
        int "Health check period (ms)"
        default 5000
        range 1000 30000
        help
            How often the health task logs heap and per-task stack
            high-water marks to serial. The /health endpoint is served on
            demand and is unaffected by this period.

    config HEALTH_LOG_TO_SERIAL
        bool "Log health data to serial"
        default y
        help
            Useful during development. Turning this off leaves the /health
            endpoint working but silences the periodic log.

endmenu
```

## components/modbus_device/Kconfig
```kconfig
menu "Modbus RTU Configuration"

    config MODBUS_RTU_UART_PORT
        int "UART port number"
        default 1
        range 0 1
        help
            UART peripheral used for the RS-485 bus. UART0 is the console.

    config MODBUS_RTU_BAUD_RATE
        int "Baud rate"
        default 9600
        help
            Must match the pymodbus slave on the Raspberry Pi
            (tools/pymodbus_slave/rtu_slave.py). Framing is fixed at 8N1.

    config MODBUS_RTU_SLAVE_ADDR
        int "Slave address"
        default 1
        range 1 247

    config MODBUS_RTU_TX_PIN
        int "TX GPIO pin"
        default 17

    config MODBUS_RTU_RX_PIN
        int "RX GPIO pin"
        default 18

    config MODBUS_RTU_DE_RE_PIN
        int "DE/RE GPIO pin"
        default 8
        help
            RS-485 direction control, driven as the UART's RTS line by
            UART_MODE_RS485_HALF_DUPLEX.

    config MODBUS_RTU_RESPONSE_TIMEOUT_MS
        int "Slave response timeout (ms)"
        default 200
        range 20 2000
        help
            Time to wait for a reply before marking every register ERROR. A
            17-byte reply at 9600 baud takes about 18 ms on the wire, so this
            leaves ample room for slave turnaround.

endmenu

menu "Modbus TCP Configuration"

    config MODBUS_TCP_IP
        string "Slave IPv4 address"
        default "192.168.1.100"
        help
            Address of the pymodbus TCP slave (tools/pymodbus_slave/tcp_slave.py).
            The Raspberry Pi must be on the same network as the ESP32's station
            interface, so this is a LAN address, not the 192.168.4.x AP subnet.

    config MODBUS_TCP_PORT
        int "Slave TCP port"
        default 5020
        range 1 65535
        help
            502 is the registered Modbus port but is privileged, so the slave
            would need root. 5020 lets the Pi run it as a normal user; both ends
            just have to agree.

    config MODBUS_TCP_UNIT_ID
        int "Unit ID (slave address in the MBAP header)"
        default 1
        range 1 247

    config MODBUS_TCP_POLL_MS
        int "Poll period (ms)"
        default 2000
        range 200 60000

    config MODBUS_TCP_TIMEOUT_MS
        int "Socket send/receive timeout (ms)"
        default 2000
        range 100 10000
        help
            Bounds both directions. Without a send timeout, a dead peer with a
            full transmit window would block the poll task indefinitely.

endmenu
```

## components/publisher/Kconfig
```kconfig
menu "Publisher Configuration"

    config WS_MAX_CLIENTS
        int "Max WebSocket clients"
        default 4
        range 1 8

    config WS_SERVER_PORT
        int "HTTP server port"
        default 80

endmenu
```
